#include <behaviors.dtsi>
#include <dt-bindings/zmk/keys.h>
#include <dt-bindings/zmk/bt.h>

#include "base.dtsi"

/ {
    chosen {
        zmk,physical-layout = &foostan_corne_6col_layout;
    };
};
